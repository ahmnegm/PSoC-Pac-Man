;
; File Name: cyfitteriar.inc
; 
; PSoC Creator  4.3
;
; Description:
; 
;
;-------------------------------------------------------------------------------
; Copyright (c) 2007-2019 Cypress Semiconductor.  All rights reserved.
; You may use this file only in accordance with the license, terms, conditions, 
; disclaimers, and limitations in the end user license agreement accompanying 
; the software package with which this file was provided.
;-------------------------------------------------------------------------------

#ifndef INCLUDED_CYFITTERIAR_INC
#define INCLUDED_CYFITTERIAR_INC
    INCLUDE cydeviceiar.inc
    INCLUDE cydeviceiar_trm.inc

/* Tx */
Tx__0__INTTYPE EQU CYREG_PICU2_INTTYPE0
Tx__0__MASK EQU 0x01
Tx__0__PC EQU CYREG_PRT2_PC0
Tx__0__PORT EQU 2
Tx__0__SHIFT EQU 0
Tx__AG EQU CYREG_PRT2_AG
Tx__AMUX EQU CYREG_PRT2_AMUX
Tx__BIE EQU CYREG_PRT2_BIE
Tx__BIT_MASK EQU CYREG_PRT2_BIT_MASK
Tx__BYP EQU CYREG_PRT2_BYP
Tx__CTL EQU CYREG_PRT2_CTL
Tx__DM0 EQU CYREG_PRT2_DM0
Tx__DM1 EQU CYREG_PRT2_DM1
Tx__DM2 EQU CYREG_PRT2_DM2
Tx__DR EQU CYREG_PRT2_DR
Tx__INP_DIS EQU CYREG_PRT2_INP_DIS
Tx__INTTYPE_BASE EQU CYDEV_PICU_INTTYPE_PICU2_BASE
Tx__LCD_COM_SEG EQU CYREG_PRT2_LCD_COM_SEG
Tx__LCD_EN EQU CYREG_PRT2_LCD_EN
Tx__MASK EQU 0x01
Tx__PORT EQU 2
Tx__PRT EQU CYREG_PRT2_PRT
Tx__PRTDSI__CAPS_SEL EQU CYREG_PRT2_CAPS_SEL
Tx__PRTDSI__DBL_SYNC_IN EQU CYREG_PRT2_DBL_SYNC_IN
Tx__PRTDSI__OE_SEL0 EQU CYREG_PRT2_OE_SEL0
Tx__PRTDSI__OE_SEL1 EQU CYREG_PRT2_OE_SEL1
Tx__PRTDSI__OUT_SEL0 EQU CYREG_PRT2_OUT_SEL0
Tx__PRTDSI__OUT_SEL1 EQU CYREG_PRT2_OUT_SEL1
Tx__PRTDSI__SYNC_OUT EQU CYREG_PRT2_SYNC_OUT
Tx__PS EQU CYREG_PRT2_PS
Tx__SHIFT EQU 0
Tx__SLW EQU CYREG_PRT2_SLW

/* DMA */
DMA__DRQ_CTL EQU CYREG_IDMUX_DRQ_CTL0
DMA__DRQ_NUMBER EQU 0
DMA__NUMBEROF_TDS EQU 0
DMA__PRIORITY EQU 0
DMA__TERMIN_EN EQU 0
DMA__TERMIN_SEL EQU 0
DMA__TERMOUT0_EN EQU 1
DMA__TERMOUT0_SEL EQU 0
DMA__TERMOUT1_EN EQU 0
DMA__TERMOUT1_SEL EQU 0
DMA_CHANNELS_USED__MASK0 EQU 0x00000001

/* VGA */
VGA__0__INTTYPE EQU CYREG_PICU12_INTTYPE2
VGA__0__MASK EQU 0x04
VGA__0__PC EQU CYREG_PRT12_PC2
VGA__0__PORT EQU 12
VGA__0__SHIFT EQU 2
VGA__1__INTTYPE EQU CYREG_PICU12_INTTYPE3
VGA__1__MASK EQU 0x08
VGA__1__PC EQU CYREG_PRT12_PC3
VGA__1__PORT EQU 12
VGA__1__SHIFT EQU 3
VGA__2__INTTYPE EQU CYREG_PICU12_INTTYPE4
VGA__2__MASK EQU 0x10
VGA__2__PC EQU CYREG_PRT12_PC4
VGA__2__PORT EQU 12
VGA__2__SHIFT EQU 4
VGA__3__INTTYPE EQU CYREG_PICU12_INTTYPE5
VGA__3__MASK EQU 0x20
VGA__3__PC EQU CYREG_PRT12_PC5
VGA__3__PORT EQU 12
VGA__3__SHIFT EQU 5
VGA__4__INTTYPE EQU CYREG_PICU12_INTTYPE6
VGA__4__MASK EQU 0x40
VGA__4__PC EQU CYREG_PRT12_PC6
VGA__4__PORT EQU 12
VGA__4__SHIFT EQU 6
VGA__5__INTTYPE EQU CYREG_PICU12_INTTYPE7
VGA__5__MASK EQU 0x80
VGA__5__PC EQU CYREG_PRT12_PC7
VGA__5__PORT EQU 12
VGA__5__SHIFT EQU 7
VGA__AG EQU CYREG_PRT12_AG
VGA__BIE EQU CYREG_PRT12_BIE
VGA__BIT_MASK EQU CYREG_PRT12_BIT_MASK
VGA__BYP EQU CYREG_PRT12_BYP
VGA__DM0 EQU CYREG_PRT12_DM0
VGA__DM1 EQU CYREG_PRT12_DM1
VGA__DM2 EQU CYREG_PRT12_DM2
VGA__DR EQU CYREG_PRT12_DR
VGA__INP_DIS EQU CYREG_PRT12_INP_DIS
VGA__INTTYPE_BASE EQU CYDEV_PICU_INTTYPE_PICU12_BASE
VGA__MASK EQU 0xFC
VGA__PORT EQU 12
VGA__PRT EQU CYREG_PRT12_PRT
VGA__PRTDSI__DBL_SYNC_IN EQU CYREG_PRT12_DBL_SYNC_IN
VGA__PRTDSI__OE_SEL0 EQU CYREG_PRT12_OE_SEL0
VGA__PRTDSI__OE_SEL1 EQU CYREG_PRT12_OE_SEL1
VGA__PRTDSI__OUT_SEL0 EQU CYREG_PRT12_OUT_SEL0
VGA__PRTDSI__OUT_SEL1 EQU CYREG_PRT12_OUT_SEL1
VGA__PRTDSI__SYNC_OUT EQU CYREG_PRT12_SYNC_OUT
VGA__PS EQU CYREG_PRT12_PS
VGA__SHIFT EQU 2
VGA__SIO_CFG EQU CYREG_PRT12_SIO_CFG
VGA__SIO_DIFF EQU CYREG_PRT12_SIO_DIFF
VGA__SIO_HYST_EN EQU CYREG_PRT12_SIO_HYST_EN
VGA__SIO_REG_HIFREQ EQU CYREG_PRT12_SIO_REG_HIFREQ
VGA__SLW EQU CYREG_PRT12_SLW
VGA_CLK__CFG0 EQU CYREG_CLKDIST_DCFG0_CFG0
VGA_CLK__CFG1 EQU CYREG_CLKDIST_DCFG0_CFG1
VGA_CLK__CFG2 EQU CYREG_CLKDIST_DCFG0_CFG2
VGA_CLK__CFG2_SRC_SEL_MASK EQU 0x07
VGA_CLK__INDEX EQU 0x00
VGA_CLK__PM_ACT_CFG EQU CYREG_PM_ACT_CFG2
VGA_CLK__PM_ACT_MSK EQU 0x01
VGA_CLK__PM_STBY_CFG EQU CYREG_PM_STBY_CFG2
VGA_CLK__PM_STBY_MSK EQU 0x01

/* VRx */
VRx__0__INTTYPE EQU CYREG_PICU1_INTTYPE5
VRx__0__MASK EQU 0x20
VRx__0__PC EQU CYREG_PRT1_PC5
VRx__0__PORT EQU 1
VRx__0__SHIFT EQU 5
VRx__AG EQU CYREG_PRT1_AG
VRx__AMUX EQU CYREG_PRT1_AMUX
VRx__BIE EQU CYREG_PRT1_BIE
VRx__BIT_MASK EQU CYREG_PRT1_BIT_MASK
VRx__BYP EQU CYREG_PRT1_BYP
VRx__CTL EQU CYREG_PRT1_CTL
VRx__DM0 EQU CYREG_PRT1_DM0
VRx__DM1 EQU CYREG_PRT1_DM1
VRx__DM2 EQU CYREG_PRT1_DM2
VRx__DR EQU CYREG_PRT1_DR
VRx__INP_DIS EQU CYREG_PRT1_INP_DIS
VRx__INTTYPE_BASE EQU CYDEV_PICU_INTTYPE_PICU1_BASE
VRx__LCD_COM_SEG EQU CYREG_PRT1_LCD_COM_SEG
VRx__LCD_EN EQU CYREG_PRT1_LCD_EN
VRx__MASK EQU 0x20
VRx__PORT EQU 1
VRx__PRT EQU CYREG_PRT1_PRT
VRx__PRTDSI__CAPS_SEL EQU CYREG_PRT1_CAPS_SEL
VRx__PRTDSI__DBL_SYNC_IN EQU CYREG_PRT1_DBL_SYNC_IN
VRx__PRTDSI__OE_SEL0 EQU CYREG_PRT1_OE_SEL0
VRx__PRTDSI__OE_SEL1 EQU CYREG_PRT1_OE_SEL1
VRx__PRTDSI__OUT_SEL0 EQU CYREG_PRT1_OUT_SEL0
VRx__PRTDSI__OUT_SEL1 EQU CYREG_PRT1_OUT_SEL1
VRx__PRTDSI__SYNC_OUT EQU CYREG_PRT1_SYNC_OUT
VRx__PS EQU CYREG_PRT1_PS
VRx__SHIFT EQU 5
VRx__SLW EQU CYREG_PRT1_SLW

/* VRy */
VRy__0__INTTYPE EQU CYREG_PICU1_INTTYPE4
VRy__0__MASK EQU 0x10
VRy__0__PC EQU CYREG_PRT1_PC4
VRy__0__PORT EQU 1
VRy__0__SHIFT EQU 4
VRy__AG EQU CYREG_PRT1_AG
VRy__AMUX EQU CYREG_PRT1_AMUX
VRy__BIE EQU CYREG_PRT1_BIE
VRy__BIT_MASK EQU CYREG_PRT1_BIT_MASK
VRy__BYP EQU CYREG_PRT1_BYP
VRy__CTL EQU CYREG_PRT1_CTL
VRy__DM0 EQU CYREG_PRT1_DM0
VRy__DM1 EQU CYREG_PRT1_DM1
VRy__DM2 EQU CYREG_PRT1_DM2
VRy__DR EQU CYREG_PRT1_DR
VRy__INP_DIS EQU CYREG_PRT1_INP_DIS
VRy__INTTYPE_BASE EQU CYDEV_PICU_INTTYPE_PICU1_BASE
VRy__LCD_COM_SEG EQU CYREG_PRT1_LCD_COM_SEG
VRy__LCD_EN EQU CYREG_PRT1_LCD_EN
VRy__MASK EQU 0x10
VRy__PORT EQU 1
VRy__PRT EQU CYREG_PRT1_PRT
VRy__PRTDSI__CAPS_SEL EQU CYREG_PRT1_CAPS_SEL
VRy__PRTDSI__DBL_SYNC_IN EQU CYREG_PRT1_DBL_SYNC_IN
VRy__PRTDSI__OE_SEL0 EQU CYREG_PRT1_OE_SEL0
VRy__PRTDSI__OE_SEL1 EQU CYREG_PRT1_OE_SEL1
VRy__PRTDSI__OUT_SEL0 EQU CYREG_PRT1_OUT_SEL0
VRy__PRTDSI__OUT_SEL1 EQU CYREG_PRT1_OUT_SEL1
VRy__PRTDSI__SYNC_OUT EQU CYREG_PRT1_SYNC_OUT
VRy__PS EQU CYREG_PRT1_PS
VRy__SHIFT EQU 4
VRy__SLW EQU CYREG_PRT1_SLW

/* UART */
UART_BUART_sTX_sCLOCK_TxBitClkGen__16BIT_A0_REG EQU CYREG_B1_UDB06_07_A0
UART_BUART_sTX_sCLOCK_TxBitClkGen__16BIT_A1_REG EQU CYREG_B1_UDB06_07_A1
UART_BUART_sTX_sCLOCK_TxBitClkGen__16BIT_D0_REG EQU CYREG_B1_UDB06_07_D0
UART_BUART_sTX_sCLOCK_TxBitClkGen__16BIT_D1_REG EQU CYREG_B1_UDB06_07_D1
UART_BUART_sTX_sCLOCK_TxBitClkGen__16BIT_DP_AUX_CTL_REG EQU CYREG_B1_UDB06_07_ACTL
UART_BUART_sTX_sCLOCK_TxBitClkGen__16BIT_F0_REG EQU CYREG_B1_UDB06_07_F0
UART_BUART_sTX_sCLOCK_TxBitClkGen__16BIT_F1_REG EQU CYREG_B1_UDB06_07_F1
UART_BUART_sTX_sCLOCK_TxBitClkGen__A0_A1_REG EQU CYREG_B1_UDB06_A0_A1
UART_BUART_sTX_sCLOCK_TxBitClkGen__A0_REG EQU CYREG_B1_UDB06_A0
UART_BUART_sTX_sCLOCK_TxBitClkGen__A1_REG EQU CYREG_B1_UDB06_A1
UART_BUART_sTX_sCLOCK_TxBitClkGen__D0_D1_REG EQU CYREG_B1_UDB06_D0_D1
UART_BUART_sTX_sCLOCK_TxBitClkGen__D0_REG EQU CYREG_B1_UDB06_D0
UART_BUART_sTX_sCLOCK_TxBitClkGen__D1_REG EQU CYREG_B1_UDB06_D1
UART_BUART_sTX_sCLOCK_TxBitClkGen__DP_AUX_CTL_REG EQU CYREG_B1_UDB06_ACTL
UART_BUART_sTX_sCLOCK_TxBitClkGen__F0_F1_REG EQU CYREG_B1_UDB06_F0_F1
UART_BUART_sTX_sCLOCK_TxBitClkGen__F0_REG EQU CYREG_B1_UDB06_F0
UART_BUART_sTX_sCLOCK_TxBitClkGen__F1_REG EQU CYREG_B1_UDB06_F1
UART_BUART_sTX_sCLOCK_TxBitClkGen__MSK_DP_AUX_CTL_REG EQU CYREG_B1_UDB06_MSK_ACTL
UART_BUART_sTX_sCLOCK_TxBitClkGen__PER_DP_AUX_CTL_REG EQU CYREG_B1_UDB06_MSK_ACTL
UART_BUART_sTX_TxShifter_u0__16BIT_A0_REG EQU CYREG_B0_UDB06_07_A0
UART_BUART_sTX_TxShifter_u0__16BIT_A1_REG EQU CYREG_B0_UDB06_07_A1
UART_BUART_sTX_TxShifter_u0__16BIT_D0_REG EQU CYREG_B0_UDB06_07_D0
UART_BUART_sTX_TxShifter_u0__16BIT_D1_REG EQU CYREG_B0_UDB06_07_D1
UART_BUART_sTX_TxShifter_u0__16BIT_DP_AUX_CTL_REG EQU CYREG_B0_UDB06_07_ACTL
UART_BUART_sTX_TxShifter_u0__16BIT_F0_REG EQU CYREG_B0_UDB06_07_F0
UART_BUART_sTX_TxShifter_u0__16BIT_F1_REG EQU CYREG_B0_UDB06_07_F1
UART_BUART_sTX_TxShifter_u0__A0_A1_REG EQU CYREG_B0_UDB06_A0_A1
UART_BUART_sTX_TxShifter_u0__A0_REG EQU CYREG_B0_UDB06_A0
UART_BUART_sTX_TxShifter_u0__A1_REG EQU CYREG_B0_UDB06_A1
UART_BUART_sTX_TxShifter_u0__D0_D1_REG EQU CYREG_B0_UDB06_D0_D1
UART_BUART_sTX_TxShifter_u0__D0_REG EQU CYREG_B0_UDB06_D0
UART_BUART_sTX_TxShifter_u0__D1_REG EQU CYREG_B0_UDB06_D1
UART_BUART_sTX_TxShifter_u0__DP_AUX_CTL_REG EQU CYREG_B0_UDB06_ACTL
UART_BUART_sTX_TxShifter_u0__F0_F1_REG EQU CYREG_B0_UDB06_F0_F1
UART_BUART_sTX_TxShifter_u0__F0_REG EQU CYREG_B0_UDB06_F0
UART_BUART_sTX_TxShifter_u0__F1_REG EQU CYREG_B0_UDB06_F1
UART_BUART_sTX_TxSts__0__MASK EQU 0x01
UART_BUART_sTX_TxSts__0__POS EQU 0
UART_BUART_sTX_TxSts__1__MASK EQU 0x02
UART_BUART_sTX_TxSts__1__POS EQU 1
UART_BUART_sTX_TxSts__16BIT_STATUS_AUX_CTL_REG EQU CYREG_B0_UDB06_07_ACTL
UART_BUART_sTX_TxSts__16BIT_STATUS_REG EQU CYREG_B0_UDB06_07_ST
UART_BUART_sTX_TxSts__2__MASK EQU 0x04
UART_BUART_sTX_TxSts__2__POS EQU 2
UART_BUART_sTX_TxSts__3__MASK EQU 0x08
UART_BUART_sTX_TxSts__3__POS EQU 3
UART_BUART_sTX_TxSts__MASK EQU 0x0F
UART_BUART_sTX_TxSts__MASK_REG EQU CYREG_B0_UDB06_MSK
UART_BUART_sTX_TxSts__STATUS_AUX_CTL_REG EQU CYREG_B0_UDB06_ACTL
UART_BUART_sTX_TxSts__STATUS_REG EQU CYREG_B0_UDB06_ST
UART_IntClock__CFG0 EQU CYREG_CLKDIST_DCFG1_CFG0
UART_IntClock__CFG1 EQU CYREG_CLKDIST_DCFG1_CFG1
UART_IntClock__CFG2 EQU CYREG_CLKDIST_DCFG1_CFG2
UART_IntClock__CFG2_SRC_SEL_MASK EQU 0x07
UART_IntClock__INDEX EQU 0x01
UART_IntClock__PM_ACT_CFG EQU CYREG_PM_ACT_CFG2
UART_IntClock__PM_ACT_MSK EQU 0x02
UART_IntClock__PM_STBY_CFG EQU CYREG_PM_STBY_CFG2
UART_IntClock__PM_STBY_MSK EQU 0x02

/* VERT */
VERT_PWMUDB_genblk1_ctrlreg__16BIT_CONTROL_AUX_CTL_REG EQU CYREG_B1_UDB04_05_ACTL
VERT_PWMUDB_genblk1_ctrlreg__16BIT_CONTROL_CONTROL_REG EQU CYREG_B1_UDB04_05_CTL
VERT_PWMUDB_genblk1_ctrlreg__16BIT_CONTROL_COUNT_REG EQU CYREG_B1_UDB04_05_CTL
VERT_PWMUDB_genblk1_ctrlreg__16BIT_COUNT_CONTROL_REG EQU CYREG_B1_UDB04_05_CTL
VERT_PWMUDB_genblk1_ctrlreg__16BIT_COUNT_COUNT_REG EQU CYREG_B1_UDB04_05_CTL
VERT_PWMUDB_genblk1_ctrlreg__16BIT_MASK_MASK_REG EQU CYREG_B1_UDB04_05_MSK
VERT_PWMUDB_genblk1_ctrlreg__16BIT_MASK_PERIOD_REG EQU CYREG_B1_UDB04_05_MSK
VERT_PWMUDB_genblk1_ctrlreg__16BIT_PERIOD_MASK_REG EQU CYREG_B1_UDB04_05_MSK
VERT_PWMUDB_genblk1_ctrlreg__16BIT_PERIOD_PERIOD_REG EQU CYREG_B1_UDB04_05_MSK
VERT_PWMUDB_genblk1_ctrlreg__7__MASK EQU 0x80
VERT_PWMUDB_genblk1_ctrlreg__7__POS EQU 7
VERT_PWMUDB_genblk1_ctrlreg__CONTROL_AUX_CTL_REG EQU CYREG_B1_UDB04_ACTL
VERT_PWMUDB_genblk1_ctrlreg__CONTROL_REG EQU CYREG_B1_UDB04_CTL
VERT_PWMUDB_genblk1_ctrlreg__CONTROL_ST_REG EQU CYREG_B1_UDB04_ST_CTL
VERT_PWMUDB_genblk1_ctrlreg__COUNT_REG EQU CYREG_B1_UDB04_CTL
VERT_PWMUDB_genblk1_ctrlreg__COUNT_ST_REG EQU CYREG_B1_UDB04_ST_CTL
VERT_PWMUDB_genblk1_ctrlreg__MASK EQU 0x80
VERT_PWMUDB_genblk1_ctrlreg__MASK_CTL_AUX_CTL_REG EQU CYREG_B1_UDB04_MSK_ACTL
VERT_PWMUDB_genblk1_ctrlreg__PER_CTL_AUX_CTL_REG EQU CYREG_B1_UDB04_MSK_ACTL
VERT_PWMUDB_genblk1_ctrlreg__PERIOD_REG EQU CYREG_B1_UDB04_MSK
VERT_PWMUDB_sP16_pwmdp_u0__16BIT_A0_REG EQU CYREG_B1_UDB10_11_A0
VERT_PWMUDB_sP16_pwmdp_u0__16BIT_A1_REG EQU CYREG_B1_UDB10_11_A1
VERT_PWMUDB_sP16_pwmdp_u0__16BIT_D0_REG EQU CYREG_B1_UDB10_11_D0
VERT_PWMUDB_sP16_pwmdp_u0__16BIT_D1_REG EQU CYREG_B1_UDB10_11_D1
VERT_PWMUDB_sP16_pwmdp_u0__16BIT_DP_AUX_CTL_REG EQU CYREG_B1_UDB10_11_ACTL
VERT_PWMUDB_sP16_pwmdp_u0__16BIT_F0_REG EQU CYREG_B1_UDB10_11_F0
VERT_PWMUDB_sP16_pwmdp_u0__16BIT_F1_REG EQU CYREG_B1_UDB10_11_F1
VERT_PWMUDB_sP16_pwmdp_u0__A0_A1_REG EQU CYREG_B1_UDB10_A0_A1
VERT_PWMUDB_sP16_pwmdp_u0__A0_REG EQU CYREG_B1_UDB10_A0
VERT_PWMUDB_sP16_pwmdp_u0__A1_REG EQU CYREG_B1_UDB10_A1
VERT_PWMUDB_sP16_pwmdp_u0__D0_D1_REG EQU CYREG_B1_UDB10_D0_D1
VERT_PWMUDB_sP16_pwmdp_u0__D0_REG EQU CYREG_B1_UDB10_D0
VERT_PWMUDB_sP16_pwmdp_u0__D1_REG EQU CYREG_B1_UDB10_D1
VERT_PWMUDB_sP16_pwmdp_u0__DP_AUX_CTL_REG EQU CYREG_B1_UDB10_ACTL
VERT_PWMUDB_sP16_pwmdp_u0__F0_F1_REG EQU CYREG_B1_UDB10_F0_F1
VERT_PWMUDB_sP16_pwmdp_u0__F0_REG EQU CYREG_B1_UDB10_F0
VERT_PWMUDB_sP16_pwmdp_u0__F1_REG EQU CYREG_B1_UDB10_F1
VERT_PWMUDB_sP16_pwmdp_u1__A0_A1_REG EQU CYREG_B1_UDB11_A0_A1
VERT_PWMUDB_sP16_pwmdp_u1__A0_REG EQU CYREG_B1_UDB11_A0
VERT_PWMUDB_sP16_pwmdp_u1__A1_REG EQU CYREG_B1_UDB11_A1
VERT_PWMUDB_sP16_pwmdp_u1__D0_D1_REG EQU CYREG_B1_UDB11_D0_D1
VERT_PWMUDB_sP16_pwmdp_u1__D0_REG EQU CYREG_B1_UDB11_D0
VERT_PWMUDB_sP16_pwmdp_u1__D1_REG EQU CYREG_B1_UDB11_D1
VERT_PWMUDB_sP16_pwmdp_u1__DP_AUX_CTL_REG EQU CYREG_B1_UDB11_ACTL
VERT_PWMUDB_sP16_pwmdp_u1__F0_F1_REG EQU CYREG_B1_UDB11_F0_F1
VERT_PWMUDB_sP16_pwmdp_u1__F0_REG EQU CYREG_B1_UDB11_F0
VERT_PWMUDB_sP16_pwmdp_u1__F1_REG EQU CYREG_B1_UDB11_F1
VERT_PWMUDB_sP16_pwmdp_u1__MSK_DP_AUX_CTL_REG EQU CYREG_B1_UDB11_MSK_ACTL
VERT_PWMUDB_sP16_pwmdp_u1__PER_DP_AUX_CTL_REG EQU CYREG_B1_UDB11_MSK_ACTL

/* HORIZ */
HORIZ_PWMUDB_genblk1_ctrlreg__16BIT_CONTROL_AUX_CTL_REG EQU CYREG_B1_UDB05_06_ACTL
HORIZ_PWMUDB_genblk1_ctrlreg__16BIT_CONTROL_CONTROL_REG EQU CYREG_B1_UDB05_06_CTL
HORIZ_PWMUDB_genblk1_ctrlreg__16BIT_CONTROL_COUNT_REG EQU CYREG_B1_UDB05_06_CTL
HORIZ_PWMUDB_genblk1_ctrlreg__16BIT_COUNT_CONTROL_REG EQU CYREG_B1_UDB05_06_CTL
HORIZ_PWMUDB_genblk1_ctrlreg__16BIT_COUNT_COUNT_REG EQU CYREG_B1_UDB05_06_CTL
HORIZ_PWMUDB_genblk1_ctrlreg__16BIT_MASK_MASK_REG EQU CYREG_B1_UDB05_06_MSK
HORIZ_PWMUDB_genblk1_ctrlreg__16BIT_MASK_PERIOD_REG EQU CYREG_B1_UDB05_06_MSK
HORIZ_PWMUDB_genblk1_ctrlreg__16BIT_PERIOD_MASK_REG EQU CYREG_B1_UDB05_06_MSK
HORIZ_PWMUDB_genblk1_ctrlreg__16BIT_PERIOD_PERIOD_REG EQU CYREG_B1_UDB05_06_MSK
HORIZ_PWMUDB_genblk1_ctrlreg__7__MASK EQU 0x80
HORIZ_PWMUDB_genblk1_ctrlreg__7__POS EQU 7
HORIZ_PWMUDB_genblk1_ctrlreg__CONTROL_AUX_CTL_REG EQU CYREG_B1_UDB05_ACTL
HORIZ_PWMUDB_genblk1_ctrlreg__CONTROL_REG EQU CYREG_B1_UDB05_CTL
HORIZ_PWMUDB_genblk1_ctrlreg__CONTROL_ST_REG EQU CYREG_B1_UDB05_ST_CTL
HORIZ_PWMUDB_genblk1_ctrlreg__COUNT_REG EQU CYREG_B1_UDB05_CTL
HORIZ_PWMUDB_genblk1_ctrlreg__COUNT_ST_REG EQU CYREG_B1_UDB05_ST_CTL
HORIZ_PWMUDB_genblk1_ctrlreg__MASK EQU 0x80
HORIZ_PWMUDB_genblk1_ctrlreg__MASK_CTL_AUX_CTL_REG EQU CYREG_B1_UDB05_MSK_ACTL
HORIZ_PWMUDB_genblk1_ctrlreg__PER_CTL_AUX_CTL_REG EQU CYREG_B1_UDB05_MSK_ACTL
HORIZ_PWMUDB_genblk1_ctrlreg__PERIOD_REG EQU CYREG_B1_UDB05_MSK
HORIZ_PWMUDB_sP8_pwmdp_u0__16BIT_A0_REG EQU CYREG_B1_UDB05_06_A0
HORIZ_PWMUDB_sP8_pwmdp_u0__16BIT_A1_REG EQU CYREG_B1_UDB05_06_A1
HORIZ_PWMUDB_sP8_pwmdp_u0__16BIT_D0_REG EQU CYREG_B1_UDB05_06_D0
HORIZ_PWMUDB_sP8_pwmdp_u0__16BIT_D1_REG EQU CYREG_B1_UDB05_06_D1
HORIZ_PWMUDB_sP8_pwmdp_u0__16BIT_DP_AUX_CTL_REG EQU CYREG_B1_UDB05_06_ACTL
HORIZ_PWMUDB_sP8_pwmdp_u0__16BIT_F0_REG EQU CYREG_B1_UDB05_06_F0
HORIZ_PWMUDB_sP8_pwmdp_u0__16BIT_F1_REG EQU CYREG_B1_UDB05_06_F1
HORIZ_PWMUDB_sP8_pwmdp_u0__A0_A1_REG EQU CYREG_B1_UDB05_A0_A1
HORIZ_PWMUDB_sP8_pwmdp_u0__A0_REG EQU CYREG_B1_UDB05_A0
HORIZ_PWMUDB_sP8_pwmdp_u0__A1_REG EQU CYREG_B1_UDB05_A1
HORIZ_PWMUDB_sP8_pwmdp_u0__D0_D1_REG EQU CYREG_B1_UDB05_D0_D1
HORIZ_PWMUDB_sP8_pwmdp_u0__D0_REG EQU CYREG_B1_UDB05_D0
HORIZ_PWMUDB_sP8_pwmdp_u0__D1_REG EQU CYREG_B1_UDB05_D1
HORIZ_PWMUDB_sP8_pwmdp_u0__DP_AUX_CTL_REG EQU CYREG_B1_UDB05_ACTL
HORIZ_PWMUDB_sP8_pwmdp_u0__F0_F1_REG EQU CYREG_B1_UDB05_F0_F1
HORIZ_PWMUDB_sP8_pwmdp_u0__F0_REG EQU CYREG_B1_UDB05_F0
HORIZ_PWMUDB_sP8_pwmdp_u0__F1_REG EQU CYREG_B1_UDB05_F1
HORIZ_PWMUDB_sP8_pwmdp_u0__MSK_DP_AUX_CTL_REG EQU CYREG_B1_UDB05_MSK_ACTL
HORIZ_PWMUDB_sP8_pwmdp_u0__PER_DP_AUX_CTL_REG EQU CYREG_B1_UDB05_MSK_ACTL

/* HSYNC */
HSYNC_OUT__0__INTTYPE EQU CYREG_PICU12_INTTYPE0
HSYNC_OUT__0__MASK EQU 0x01
HSYNC_OUT__0__PC EQU CYREG_PRT12_PC0
HSYNC_OUT__0__PORT EQU 12
HSYNC_OUT__0__SHIFT EQU 0
HSYNC_OUT__AG EQU CYREG_PRT12_AG
HSYNC_OUT__BIE EQU CYREG_PRT12_BIE
HSYNC_OUT__BIT_MASK EQU CYREG_PRT12_BIT_MASK
HSYNC_OUT__BYP EQU CYREG_PRT12_BYP
HSYNC_OUT__DM0 EQU CYREG_PRT12_DM0
HSYNC_OUT__DM1 EQU CYREG_PRT12_DM1
HSYNC_OUT__DM2 EQU CYREG_PRT12_DM2
HSYNC_OUT__DR EQU CYREG_PRT12_DR
HSYNC_OUT__INP_DIS EQU CYREG_PRT12_INP_DIS
HSYNC_OUT__INTTYPE_BASE EQU CYDEV_PICU_INTTYPE_PICU12_BASE
HSYNC_OUT__MASK EQU 0x01
HSYNC_OUT__PORT EQU 12
HSYNC_OUT__PRT EQU CYREG_PRT12_PRT
HSYNC_OUT__PRTDSI__DBL_SYNC_IN EQU CYREG_PRT12_DBL_SYNC_IN
HSYNC_OUT__PRTDSI__OE_SEL0 EQU CYREG_PRT12_OE_SEL0
HSYNC_OUT__PRTDSI__OE_SEL1 EQU CYREG_PRT12_OE_SEL1
HSYNC_OUT__PRTDSI__OUT_SEL0 EQU CYREG_PRT12_OUT_SEL0
HSYNC_OUT__PRTDSI__OUT_SEL1 EQU CYREG_PRT12_OUT_SEL1
HSYNC_OUT__PRTDSI__SYNC_OUT EQU CYREG_PRT12_SYNC_OUT
HSYNC_OUT__PS EQU CYREG_PRT12_PS
HSYNC_OUT__SHIFT EQU 0
HSYNC_OUT__SIO_CFG EQU CYREG_PRT12_SIO_CFG
HSYNC_OUT__SIO_DIFF EQU CYREG_PRT12_SIO_DIFF
HSYNC_OUT__SIO_HYST_EN EQU CYREG_PRT12_SIO_HYST_EN
HSYNC_OUT__SIO_REG_HIFREQ EQU CYREG_PRT12_SIO_REG_HIFREQ
HSYNC_OUT__SLW EQU CYREG_PRT12_SLW
HSYNC_PWMUDB_genblk1_ctrlreg__16BIT_CONTROL_AUX_CTL_REG EQU CYREG_B1_UDB06_07_ACTL
HSYNC_PWMUDB_genblk1_ctrlreg__16BIT_CONTROL_CONTROL_REG EQU CYREG_B1_UDB06_07_CTL
HSYNC_PWMUDB_genblk1_ctrlreg__16BIT_CONTROL_COUNT_REG EQU CYREG_B1_UDB06_07_CTL
HSYNC_PWMUDB_genblk1_ctrlreg__16BIT_COUNT_CONTROL_REG EQU CYREG_B1_UDB06_07_CTL
HSYNC_PWMUDB_genblk1_ctrlreg__16BIT_COUNT_COUNT_REG EQU CYREG_B1_UDB06_07_CTL
HSYNC_PWMUDB_genblk1_ctrlreg__16BIT_MASK_MASK_REG EQU CYREG_B1_UDB06_07_MSK
HSYNC_PWMUDB_genblk1_ctrlreg__16BIT_MASK_PERIOD_REG EQU CYREG_B1_UDB06_07_MSK
HSYNC_PWMUDB_genblk1_ctrlreg__16BIT_PERIOD_MASK_REG EQU CYREG_B1_UDB06_07_MSK
HSYNC_PWMUDB_genblk1_ctrlreg__16BIT_PERIOD_PERIOD_REG EQU CYREG_B1_UDB06_07_MSK
HSYNC_PWMUDB_genblk1_ctrlreg__7__MASK EQU 0x80
HSYNC_PWMUDB_genblk1_ctrlreg__7__POS EQU 7
HSYNC_PWMUDB_genblk1_ctrlreg__CONTROL_AUX_CTL_REG EQU CYREG_B1_UDB06_ACTL
HSYNC_PWMUDB_genblk1_ctrlreg__CONTROL_REG EQU CYREG_B1_UDB06_CTL
HSYNC_PWMUDB_genblk1_ctrlreg__CONTROL_ST_REG EQU CYREG_B1_UDB06_ST_CTL
HSYNC_PWMUDB_genblk1_ctrlreg__COUNT_REG EQU CYREG_B1_UDB06_CTL
HSYNC_PWMUDB_genblk1_ctrlreg__COUNT_ST_REG EQU CYREG_B1_UDB06_ST_CTL
HSYNC_PWMUDB_genblk1_ctrlreg__MASK EQU 0x80
HSYNC_PWMUDB_genblk1_ctrlreg__MASK_CTL_AUX_CTL_REG EQU CYREG_B1_UDB06_MSK_ACTL
HSYNC_PWMUDB_genblk1_ctrlreg__PER_CTL_AUX_CTL_REG EQU CYREG_B1_UDB06_MSK_ACTL
HSYNC_PWMUDB_genblk1_ctrlreg__PERIOD_REG EQU CYREG_B1_UDB06_MSK
HSYNC_PWMUDB_sP8_pwmdp_u0__16BIT_A0_REG EQU CYREG_B1_UDB07_08_A0
HSYNC_PWMUDB_sP8_pwmdp_u0__16BIT_A1_REG EQU CYREG_B1_UDB07_08_A1
HSYNC_PWMUDB_sP8_pwmdp_u0__16BIT_D0_REG EQU CYREG_B1_UDB07_08_D0
HSYNC_PWMUDB_sP8_pwmdp_u0__16BIT_D1_REG EQU CYREG_B1_UDB07_08_D1
HSYNC_PWMUDB_sP8_pwmdp_u0__16BIT_DP_AUX_CTL_REG EQU CYREG_B1_UDB07_08_ACTL
HSYNC_PWMUDB_sP8_pwmdp_u0__16BIT_F0_REG EQU CYREG_B1_UDB07_08_F0
HSYNC_PWMUDB_sP8_pwmdp_u0__16BIT_F1_REG EQU CYREG_B1_UDB07_08_F1
HSYNC_PWMUDB_sP8_pwmdp_u0__A0_A1_REG EQU CYREG_B1_UDB07_A0_A1
HSYNC_PWMUDB_sP8_pwmdp_u0__A0_REG EQU CYREG_B1_UDB07_A0
HSYNC_PWMUDB_sP8_pwmdp_u0__A1_REG EQU CYREG_B1_UDB07_A1
HSYNC_PWMUDB_sP8_pwmdp_u0__D0_D1_REG EQU CYREG_B1_UDB07_D0_D1
HSYNC_PWMUDB_sP8_pwmdp_u0__D0_REG EQU CYREG_B1_UDB07_D0
HSYNC_PWMUDB_sP8_pwmdp_u0__D1_REG EQU CYREG_B1_UDB07_D1
HSYNC_PWMUDB_sP8_pwmdp_u0__DP_AUX_CTL_REG EQU CYREG_B1_UDB07_ACTL
HSYNC_PWMUDB_sP8_pwmdp_u0__F0_F1_REG EQU CYREG_B1_UDB07_F0_F1
HSYNC_PWMUDB_sP8_pwmdp_u0__F0_REG EQU CYREG_B1_UDB07_F0
HSYNC_PWMUDB_sP8_pwmdp_u0__F1_REG EQU CYREG_B1_UDB07_F1
HSYNC_PWMUDB_sP8_pwmdp_u0__MSK_DP_AUX_CTL_REG EQU CYREG_B1_UDB07_MSK_ACTL
HSYNC_PWMUDB_sP8_pwmdp_u0__PER_DP_AUX_CTL_REG EQU CYREG_B1_UDB07_MSK_ACTL

/* PIXEL */
PIXEL_Sync_ctrl_reg__0__MASK EQU 0x01
PIXEL_Sync_ctrl_reg__0__POS EQU 0
PIXEL_Sync_ctrl_reg__1__MASK EQU 0x02
PIXEL_Sync_ctrl_reg__1__POS EQU 1
PIXEL_Sync_ctrl_reg__16BIT_CONTROL_AUX_CTL_REG EQU CYREG_B1_UDB07_08_ACTL
PIXEL_Sync_ctrl_reg__16BIT_CONTROL_CONTROL_REG EQU CYREG_B1_UDB07_08_CTL
PIXEL_Sync_ctrl_reg__16BIT_CONTROL_COUNT_REG EQU CYREG_B1_UDB07_08_CTL
PIXEL_Sync_ctrl_reg__16BIT_COUNT_CONTROL_REG EQU CYREG_B1_UDB07_08_CTL
PIXEL_Sync_ctrl_reg__16BIT_COUNT_COUNT_REG EQU CYREG_B1_UDB07_08_CTL
PIXEL_Sync_ctrl_reg__16BIT_MASK_MASK_REG EQU CYREG_B1_UDB07_08_MSK
PIXEL_Sync_ctrl_reg__16BIT_MASK_PERIOD_REG EQU CYREG_B1_UDB07_08_MSK
PIXEL_Sync_ctrl_reg__16BIT_PERIOD_MASK_REG EQU CYREG_B1_UDB07_08_MSK
PIXEL_Sync_ctrl_reg__16BIT_PERIOD_PERIOD_REG EQU CYREG_B1_UDB07_08_MSK
PIXEL_Sync_ctrl_reg__2__MASK EQU 0x04
PIXEL_Sync_ctrl_reg__2__POS EQU 2
PIXEL_Sync_ctrl_reg__3__MASK EQU 0x08
PIXEL_Sync_ctrl_reg__3__POS EQU 3
PIXEL_Sync_ctrl_reg__4__MASK EQU 0x10
PIXEL_Sync_ctrl_reg__4__POS EQU 4
PIXEL_Sync_ctrl_reg__5__MASK EQU 0x20
PIXEL_Sync_ctrl_reg__5__POS EQU 5
PIXEL_Sync_ctrl_reg__CONTROL_AUX_CTL_REG EQU CYREG_B1_UDB07_ACTL
PIXEL_Sync_ctrl_reg__CONTROL_REG EQU CYREG_B1_UDB07_CTL
PIXEL_Sync_ctrl_reg__CONTROL_ST_REG EQU CYREG_B1_UDB07_ST_CTL
PIXEL_Sync_ctrl_reg__COUNT_REG EQU CYREG_B1_UDB07_CTL
PIXEL_Sync_ctrl_reg__COUNT_ST_REG EQU CYREG_B1_UDB07_ST_CTL
PIXEL_Sync_ctrl_reg__MASK EQU 0x3F
PIXEL_Sync_ctrl_reg__MASK_CTL_AUX_CTL_REG EQU CYREG_B1_UDB07_MSK_ACTL
PIXEL_Sync_ctrl_reg__PER_CTL_AUX_CTL_REG EQU CYREG_B1_UDB07_MSK_ACTL
PIXEL_Sync_ctrl_reg__PERIOD_REG EQU CYREG_B1_UDB07_MSK

/* VSYNC */
VSYNC_OUT__0__INTTYPE EQU CYREG_PICU12_INTTYPE1
VSYNC_OUT__0__MASK EQU 0x02
VSYNC_OUT__0__PC EQU CYREG_PRT12_PC1
VSYNC_OUT__0__PORT EQU 12
VSYNC_OUT__0__SHIFT EQU 1
VSYNC_OUT__AG EQU CYREG_PRT12_AG
VSYNC_OUT__BIE EQU CYREG_PRT12_BIE
VSYNC_OUT__BIT_MASK EQU CYREG_PRT12_BIT_MASK
VSYNC_OUT__BYP EQU CYREG_PRT12_BYP
VSYNC_OUT__DM0 EQU CYREG_PRT12_DM0
VSYNC_OUT__DM1 EQU CYREG_PRT12_DM1
VSYNC_OUT__DM2 EQU CYREG_PRT12_DM2
VSYNC_OUT__DR EQU CYREG_PRT12_DR
VSYNC_OUT__INP_DIS EQU CYREG_PRT12_INP_DIS
VSYNC_OUT__INTTYPE_BASE EQU CYDEV_PICU_INTTYPE_PICU12_BASE
VSYNC_OUT__MASK EQU 0x02
VSYNC_OUT__PORT EQU 12
VSYNC_OUT__PRT EQU CYREG_PRT12_PRT
VSYNC_OUT__PRTDSI__DBL_SYNC_IN EQU CYREG_PRT12_DBL_SYNC_IN
VSYNC_OUT__PRTDSI__OE_SEL0 EQU CYREG_PRT12_OE_SEL0
VSYNC_OUT__PRTDSI__OE_SEL1 EQU CYREG_PRT12_OE_SEL1
VSYNC_OUT__PRTDSI__OUT_SEL0 EQU CYREG_PRT12_OUT_SEL0
VSYNC_OUT__PRTDSI__OUT_SEL1 EQU CYREG_PRT12_OUT_SEL1
VSYNC_OUT__PRTDSI__SYNC_OUT EQU CYREG_PRT12_SYNC_OUT
VSYNC_OUT__PS EQU CYREG_PRT12_PS
VSYNC_OUT__SHIFT EQU 1
VSYNC_OUT__SIO_CFG EQU CYREG_PRT12_SIO_CFG
VSYNC_OUT__SIO_DIFF EQU CYREG_PRT12_SIO_DIFF
VSYNC_OUT__SIO_HYST_EN EQU CYREG_PRT12_SIO_HYST_EN
VSYNC_OUT__SIO_REG_HIFREQ EQU CYREG_PRT12_SIO_REG_HIFREQ
VSYNC_OUT__SLW EQU CYREG_PRT12_SLW
VSYNC_PWMUDB_genblk1_ctrlreg__7__MASK EQU 0x80
VSYNC_PWMUDB_genblk1_ctrlreg__7__POS EQU 7
VSYNC_PWMUDB_genblk1_ctrlreg__CONTROL_AUX_CTL_REG EQU CYREG_B1_UDB11_ACTL
VSYNC_PWMUDB_genblk1_ctrlreg__CONTROL_REG EQU CYREG_B1_UDB11_CTL
VSYNC_PWMUDB_genblk1_ctrlreg__CONTROL_ST_REG EQU CYREG_B1_UDB11_ST_CTL
VSYNC_PWMUDB_genblk1_ctrlreg__COUNT_REG EQU CYREG_B1_UDB11_CTL
VSYNC_PWMUDB_genblk1_ctrlreg__COUNT_ST_REG EQU CYREG_B1_UDB11_ST_CTL
VSYNC_PWMUDB_genblk1_ctrlreg__MASK EQU 0x80
VSYNC_PWMUDB_genblk1_ctrlreg__MASK_CTL_AUX_CTL_REG EQU CYREG_B1_UDB11_MSK_ACTL
VSYNC_PWMUDB_genblk1_ctrlreg__PER_CTL_AUX_CTL_REG EQU CYREG_B1_UDB11_MSK_ACTL
VSYNC_PWMUDB_genblk1_ctrlreg__PERIOD_REG EQU CYREG_B1_UDB11_MSK
VSYNC_PWMUDB_sP8_pwmdp_u0__16BIT_A0_REG EQU CYREG_B1_UDB04_05_A0
VSYNC_PWMUDB_sP8_pwmdp_u0__16BIT_A1_REG EQU CYREG_B1_UDB04_05_A1
VSYNC_PWMUDB_sP8_pwmdp_u0__16BIT_D0_REG EQU CYREG_B1_UDB04_05_D0
VSYNC_PWMUDB_sP8_pwmdp_u0__16BIT_D1_REG EQU CYREG_B1_UDB04_05_D1
VSYNC_PWMUDB_sP8_pwmdp_u0__16BIT_DP_AUX_CTL_REG EQU CYREG_B1_UDB04_05_ACTL
VSYNC_PWMUDB_sP8_pwmdp_u0__16BIT_F0_REG EQU CYREG_B1_UDB04_05_F0
VSYNC_PWMUDB_sP8_pwmdp_u0__16BIT_F1_REG EQU CYREG_B1_UDB04_05_F1
VSYNC_PWMUDB_sP8_pwmdp_u0__A0_A1_REG EQU CYREG_B1_UDB04_A0_A1
VSYNC_PWMUDB_sP8_pwmdp_u0__A0_REG EQU CYREG_B1_UDB04_A0
VSYNC_PWMUDB_sP8_pwmdp_u0__A1_REG EQU CYREG_B1_UDB04_A1
VSYNC_PWMUDB_sP8_pwmdp_u0__D0_D1_REG EQU CYREG_B1_UDB04_D0_D1
VSYNC_PWMUDB_sP8_pwmdp_u0__D0_REG EQU CYREG_B1_UDB04_D0
VSYNC_PWMUDB_sP8_pwmdp_u0__D1_REG EQU CYREG_B1_UDB04_D1
VSYNC_PWMUDB_sP8_pwmdp_u0__DP_AUX_CTL_REG EQU CYREG_B1_UDB04_ACTL
VSYNC_PWMUDB_sP8_pwmdp_u0__F0_F1_REG EQU CYREG_B1_UDB04_F0_F1
VSYNC_PWMUDB_sP8_pwmdp_u0__F0_REG EQU CYREG_B1_UDB04_F0
VSYNC_PWMUDB_sP8_pwmdp_u0__F1_REG EQU CYREG_B1_UDB04_F1
VSYNC_PWMUDB_sP8_pwmdp_u0__MSK_DP_AUX_CTL_REG EQU CYREG_B1_UDB04_MSK_ACTL
VSYNC_PWMUDB_sP8_pwmdp_u0__PER_DP_AUX_CTL_REG EQU CYREG_B1_UDB04_MSK_ACTL

/* NEWLINE */
NEWLINE__INTC_CLR_EN_REG EQU CYREG_NVIC_CLRENA0
NEWLINE__INTC_CLR_PD_REG EQU CYREG_NVIC_CLRPEND0
NEWLINE__INTC_MASK EQU 0x01
NEWLINE__INTC_NUMBER EQU 0
NEWLINE__INTC_PRIOR_NUM EQU 7
NEWLINE__INTC_PRIOR_REG EQU CYREG_NVIC_PRI_0
NEWLINE__INTC_SET_EN_REG EQU CYREG_NVIC_SETENA0
NEWLINE__INTC_SET_PD_REG EQU CYREG_NVIC_SETPEND0

/* ADC_SAR_1 */
ADC_SAR_1_ADC_SAR__CLK EQU CYREG_SAR0_CLK
ADC_SAR_1_ADC_SAR__CSR0 EQU CYREG_SAR0_CSR0
ADC_SAR_1_ADC_SAR__CSR1 EQU CYREG_SAR0_CSR1
ADC_SAR_1_ADC_SAR__CSR2 EQU CYREG_SAR0_CSR2
ADC_SAR_1_ADC_SAR__CSR3 EQU CYREG_SAR0_CSR3
ADC_SAR_1_ADC_SAR__CSR4 EQU CYREG_SAR0_CSR4
ADC_SAR_1_ADC_SAR__CSR5 EQU CYREG_SAR0_CSR5
ADC_SAR_1_ADC_SAR__CSR6 EQU CYREG_SAR0_CSR6
ADC_SAR_1_ADC_SAR__PM_ACT_CFG EQU CYREG_PM_ACT_CFG11
ADC_SAR_1_ADC_SAR__PM_ACT_MSK EQU 0x01
ADC_SAR_1_ADC_SAR__PM_STBY_CFG EQU CYREG_PM_STBY_CFG11
ADC_SAR_1_ADC_SAR__PM_STBY_MSK EQU 0x01
ADC_SAR_1_ADC_SAR__SW0 EQU CYREG_SAR0_SW0
ADC_SAR_1_ADC_SAR__SW2 EQU CYREG_SAR0_SW2
ADC_SAR_1_ADC_SAR__SW3 EQU CYREG_SAR0_SW3
ADC_SAR_1_ADC_SAR__SW4 EQU CYREG_SAR0_SW4
ADC_SAR_1_ADC_SAR__SW6 EQU CYREG_SAR0_SW6
ADC_SAR_1_ADC_SAR__TR0 EQU CYREG_SAR0_TR0
ADC_SAR_1_ADC_SAR__WRK0 EQU CYREG_SAR0_WRK0
ADC_SAR_1_ADC_SAR__WRK1 EQU CYREG_SAR0_WRK1
ADC_SAR_1_IRQ__INTC_CLR_EN_REG EQU CYREG_NVIC_CLRENA0
ADC_SAR_1_IRQ__INTC_CLR_PD_REG EQU CYREG_NVIC_CLRPEND0
ADC_SAR_1_IRQ__INTC_MASK EQU 0x02
ADC_SAR_1_IRQ__INTC_NUMBER EQU 1
ADC_SAR_1_IRQ__INTC_PRIOR_NUM EQU 7
ADC_SAR_1_IRQ__INTC_PRIOR_REG EQU CYREG_NVIC_PRI_1
ADC_SAR_1_IRQ__INTC_SET_EN_REG EQU CYREG_NVIC_SETENA0
ADC_SAR_1_IRQ__INTC_SET_PD_REG EQU CYREG_NVIC_SETPEND0
ADC_SAR_1_theACLK__CFG0 EQU CYREG_CLKDIST_ACFG1_CFG0
ADC_SAR_1_theACLK__CFG1 EQU CYREG_CLKDIST_ACFG1_CFG1
ADC_SAR_1_theACLK__CFG2 EQU CYREG_CLKDIST_ACFG1_CFG2
ADC_SAR_1_theACLK__CFG2_SRC_SEL_MASK EQU 0x07
ADC_SAR_1_theACLK__CFG3 EQU CYREG_CLKDIST_ACFG1_CFG3
ADC_SAR_1_theACLK__CFG3_PHASE_DLY_MASK EQU 0x0F
ADC_SAR_1_theACLK__INDEX EQU 0x01
ADC_SAR_1_theACLK__PM_ACT_CFG EQU CYREG_PM_ACT_CFG1
ADC_SAR_1_theACLK__PM_ACT_MSK EQU 0x02
ADC_SAR_1_theACLK__PM_STBY_CFG EQU CYREG_PM_STBY_CFG1
ADC_SAR_1_theACLK__PM_STBY_MSK EQU 0x02

/* ADC_SAR_2 */
ADC_SAR_2_ADC_SAR__CLK EQU CYREG_SAR1_CLK
ADC_SAR_2_ADC_SAR__CSR0 EQU CYREG_SAR1_CSR0
ADC_SAR_2_ADC_SAR__CSR1 EQU CYREG_SAR1_CSR1
ADC_SAR_2_ADC_SAR__CSR2 EQU CYREG_SAR1_CSR2
ADC_SAR_2_ADC_SAR__CSR3 EQU CYREG_SAR1_CSR3
ADC_SAR_2_ADC_SAR__CSR4 EQU CYREG_SAR1_CSR4
ADC_SAR_2_ADC_SAR__CSR5 EQU CYREG_SAR1_CSR5
ADC_SAR_2_ADC_SAR__CSR6 EQU CYREG_SAR1_CSR6
ADC_SAR_2_ADC_SAR__PM_ACT_CFG EQU CYREG_PM_ACT_CFG11
ADC_SAR_2_ADC_SAR__PM_ACT_MSK EQU 0x02
ADC_SAR_2_ADC_SAR__PM_STBY_CFG EQU CYREG_PM_STBY_CFG11
ADC_SAR_2_ADC_SAR__PM_STBY_MSK EQU 0x02
ADC_SAR_2_ADC_SAR__SW0 EQU CYREG_SAR1_SW0
ADC_SAR_2_ADC_SAR__SW2 EQU CYREG_SAR1_SW2
ADC_SAR_2_ADC_SAR__SW3 EQU CYREG_SAR1_SW3
ADC_SAR_2_ADC_SAR__SW4 EQU CYREG_SAR1_SW4
ADC_SAR_2_ADC_SAR__SW6 EQU CYREG_SAR1_SW6
ADC_SAR_2_ADC_SAR__TR0 EQU CYREG_SAR1_TR0
ADC_SAR_2_ADC_SAR__WRK0 EQU CYREG_SAR1_WRK0
ADC_SAR_2_ADC_SAR__WRK1 EQU CYREG_SAR1_WRK1
ADC_SAR_2_IRQ__INTC_CLR_EN_REG EQU CYREG_NVIC_CLRENA0
ADC_SAR_2_IRQ__INTC_CLR_PD_REG EQU CYREG_NVIC_CLRPEND0
ADC_SAR_2_IRQ__INTC_MASK EQU 0x04
ADC_SAR_2_IRQ__INTC_NUMBER EQU 2
ADC_SAR_2_IRQ__INTC_PRIOR_NUM EQU 7
ADC_SAR_2_IRQ__INTC_PRIOR_REG EQU CYREG_NVIC_PRI_2
ADC_SAR_2_IRQ__INTC_SET_EN_REG EQU CYREG_NVIC_SETENA0
ADC_SAR_2_IRQ__INTC_SET_PD_REG EQU CYREG_NVIC_SETPEND0
ADC_SAR_2_theACLK__CFG0 EQU CYREG_CLKDIST_ACFG0_CFG0
ADC_SAR_2_theACLK__CFG1 EQU CYREG_CLKDIST_ACFG0_CFG1
ADC_SAR_2_theACLK__CFG2 EQU CYREG_CLKDIST_ACFG0_CFG2
ADC_SAR_2_theACLK__CFG2_SRC_SEL_MASK EQU 0x07
ADC_SAR_2_theACLK__CFG3 EQU CYREG_CLKDIST_ACFG0_CFG3
ADC_SAR_2_theACLK__CFG3_PHASE_DLY_MASK EQU 0x0F
ADC_SAR_2_theACLK__INDEX EQU 0x00
ADC_SAR_2_theACLK__PM_ACT_CFG EQU CYREG_PM_ACT_CFG1
ADC_SAR_2_theACLK__PM_ACT_MSK EQU 0x01
ADC_SAR_2_theACLK__PM_STBY_CFG EQU CYREG_PM_STBY_CFG1
ADC_SAR_2_theACLK__PM_STBY_MSK EQU 0x01

/* Miscellaneous */
BCLK__BUS_CLK__HZ EQU 65000000
BCLK__BUS_CLK__KHZ EQU 65000
BCLK__BUS_CLK__MHZ EQU 65
CYDEV_CHIP_DIE_LEOPARD EQU 1
CYDEV_CHIP_DIE_PSOC4A EQU 24
CYDEV_CHIP_DIE_PSOC5LP EQU 2
CYDEV_CHIP_DIE_PSOC5TM EQU 3
CYDEV_CHIP_DIE_TMA4 EQU 4
CYDEV_CHIP_DIE_UNKNOWN EQU 0
CYDEV_CHIP_FAMILY_FM0P EQU 5
CYDEV_CHIP_FAMILY_FM3 EQU 6
CYDEV_CHIP_FAMILY_FM4 EQU 7
CYDEV_CHIP_FAMILY_PSOC3 EQU 1
CYDEV_CHIP_FAMILY_PSOC4 EQU 2
CYDEV_CHIP_FAMILY_PSOC5 EQU 3
CYDEV_CHIP_FAMILY_PSOC6 EQU 4
CYDEV_CHIP_FAMILY_UNKNOWN EQU 0
CYDEV_CHIP_FAMILY_USED EQU CYDEV_CHIP_FAMILY_PSOC5
CYDEV_CHIP_JTAG_ID EQU 0x2E161069
CYDEV_CHIP_MEMBER_3A EQU 1
CYDEV_CHIP_MEMBER_4A EQU 24
CYDEV_CHIP_MEMBER_4AA EQU 23
CYDEV_CHIP_MEMBER_4AB EQU 28
CYDEV_CHIP_MEMBER_4AC EQU 14
CYDEV_CHIP_MEMBER_4D EQU 18
CYDEV_CHIP_MEMBER_4E EQU 6
CYDEV_CHIP_MEMBER_4F EQU 25
CYDEV_CHIP_MEMBER_4G EQU 4
CYDEV_CHIP_MEMBER_4H EQU 22
CYDEV_CHIP_MEMBER_4I EQU 30
CYDEV_CHIP_MEMBER_4J EQU 19
CYDEV_CHIP_MEMBER_4K EQU 20
CYDEV_CHIP_MEMBER_4L EQU 29
CYDEV_CHIP_MEMBER_4M EQU 27
CYDEV_CHIP_MEMBER_4N EQU 11
CYDEV_CHIP_MEMBER_4O EQU 8
CYDEV_CHIP_MEMBER_4P EQU 26
CYDEV_CHIP_MEMBER_4Q EQU 15
CYDEV_CHIP_MEMBER_4R EQU 9
CYDEV_CHIP_MEMBER_4S EQU 12
CYDEV_CHIP_MEMBER_4T EQU 10
CYDEV_CHIP_MEMBER_4U EQU 5
CYDEV_CHIP_MEMBER_4V EQU 21
CYDEV_CHIP_MEMBER_4W EQU 13
CYDEV_CHIP_MEMBER_4X EQU 7
CYDEV_CHIP_MEMBER_4Y EQU 16
CYDEV_CHIP_MEMBER_4Z EQU 17
CYDEV_CHIP_MEMBER_5A EQU 3
CYDEV_CHIP_MEMBER_5B EQU 2
CYDEV_CHIP_MEMBER_6A EQU 31
CYDEV_CHIP_MEMBER_FM3 EQU 35
CYDEV_CHIP_MEMBER_FM4 EQU 36
CYDEV_CHIP_MEMBER_PDL_FM0P_TYPE1 EQU 32
CYDEV_CHIP_MEMBER_PDL_FM0P_TYPE2 EQU 33
CYDEV_CHIP_MEMBER_PDL_FM0P_TYPE3 EQU 34
CYDEV_CHIP_MEMBER_UNKNOWN EQU 0
CYDEV_CHIP_MEMBER_USED EQU CYDEV_CHIP_MEMBER_5B
CYDEV_CHIP_DIE_EXPECT EQU CYDEV_CHIP_MEMBER_USED
CYDEV_CHIP_DIE_ACTUAL EQU CYDEV_CHIP_DIE_EXPECT
CYDEV_CHIP_REV_LEOPARD_ES1 EQU 0
CYDEV_CHIP_REV_LEOPARD_ES2 EQU 1
CYDEV_CHIP_REV_LEOPARD_ES3 EQU 3
CYDEV_CHIP_REV_LEOPARD_PRODUCTION EQU 3
CYDEV_CHIP_REV_PSOC4A_ES0 EQU 17
CYDEV_CHIP_REV_PSOC4A_PRODUCTION EQU 17
CYDEV_CHIP_REV_PSOC5LP_ES0 EQU 0
CYDEV_CHIP_REV_PSOC5LP_PRODUCTION EQU 0
CYDEV_CHIP_REV_PSOC5TM_ES0 EQU 0
CYDEV_CHIP_REV_PSOC5TM_ES1 EQU 1
CYDEV_CHIP_REV_PSOC5TM_PRODUCTION EQU 1
CYDEV_CHIP_REV_TMA4_ES EQU 17
CYDEV_CHIP_REV_TMA4_ES2 EQU 33
CYDEV_CHIP_REV_TMA4_PRODUCTION EQU 17
CYDEV_CHIP_REVISION_3A_ES1 EQU 0
CYDEV_CHIP_REVISION_3A_ES2 EQU 1
CYDEV_CHIP_REVISION_3A_ES3 EQU 3
CYDEV_CHIP_REVISION_3A_PRODUCTION EQU 3
CYDEV_CHIP_REVISION_4A_ES0 EQU 17
CYDEV_CHIP_REVISION_4A_PRODUCTION EQU 17
CYDEV_CHIP_REVISION_4AA_PRODUCTION EQU 0
CYDEV_CHIP_REVISION_4AB_PRODUCTION EQU 0
CYDEV_CHIP_REVISION_4AC_PRODUCTION EQU 0
CYDEV_CHIP_REVISION_4D_PRODUCTION EQU 0
CYDEV_CHIP_REVISION_4E_CCG2_NO_USBPD EQU 0
CYDEV_CHIP_REVISION_4E_PRODUCTION EQU 0
CYDEV_CHIP_REVISION_4F_PRODUCTION EQU 0
CYDEV_CHIP_REVISION_4F_PRODUCTION_256DMA EQU 0
CYDEV_CHIP_REVISION_4F_PRODUCTION_256K EQU 0
CYDEV_CHIP_REVISION_4G_ES EQU 17
CYDEV_CHIP_REVISION_4G_ES2 EQU 33
CYDEV_CHIP_REVISION_4G_PRODUCTION EQU 17
CYDEV_CHIP_REVISION_4H_PRODUCTION EQU 0
CYDEV_CHIP_REVISION_4I_PRODUCTION EQU 0
CYDEV_CHIP_REVISION_4J_PRODUCTION EQU 0
CYDEV_CHIP_REVISION_4K_PRODUCTION EQU 0
CYDEV_CHIP_REVISION_4L_PRODUCTION EQU 0
CYDEV_CHIP_REVISION_4M_PRODUCTION EQU 0
CYDEV_CHIP_REVISION_4N_PRODUCTION EQU 0
CYDEV_CHIP_REVISION_4O_PRODUCTION EQU 0
CYDEV_CHIP_REVISION_4P_PRODUCTION EQU 0
CYDEV_CHIP_REVISION_4Q_PRODUCTION EQU 0
CYDEV_CHIP_REVISION_4R_PRODUCTION EQU 0
CYDEV_CHIP_REVISION_4S_PRODUCTION EQU 0
CYDEV_CHIP_REVISION_4T_PRODUCTION EQU 0
CYDEV_CHIP_REVISION_4U_PRODUCTION EQU 0
CYDEV_CHIP_REVISION_4V_PRODUCTION EQU 0
CYDEV_CHIP_REVISION_4W_PRODUCTION EQU 0
CYDEV_CHIP_REVISION_4X_PRODUCTION EQU 0
CYDEV_CHIP_REVISION_4Y_PRODUCTION EQU 0
CYDEV_CHIP_REVISION_4Z_PRODUCTION EQU 0
CYDEV_CHIP_REVISION_5A_ES0 EQU 0
CYDEV_CHIP_REVISION_5A_ES1 EQU 1
CYDEV_CHIP_REVISION_5A_PRODUCTION EQU 1
CYDEV_CHIP_REVISION_5B_ES0 EQU 0
CYDEV_CHIP_REVISION_5B_PRODUCTION EQU 0
CYDEV_CHIP_REVISION_6A_ES EQU 17
CYDEV_CHIP_REVISION_6A_NO_UDB EQU 33
CYDEV_CHIP_REVISION_6A_PRODUCTION EQU 33
CYDEV_CHIP_REVISION_FM3_PRODUCTION EQU 0
CYDEV_CHIP_REVISION_FM4_PRODUCTION EQU 0
CYDEV_CHIP_REVISION_PDL_FM0P_TYPE1_PRODUCTION EQU 0
CYDEV_CHIP_REVISION_PDL_FM0P_TYPE2_PRODUCTION EQU 0
CYDEV_CHIP_REVISION_PDL_FM0P_TYPE3_PRODUCTION EQU 0
CYDEV_CHIP_REVISION_USED EQU CYDEV_CHIP_REVISION_5B_PRODUCTION
CYDEV_CHIP_REV_EXPECT EQU CYDEV_CHIP_REVISION_USED
CYDEV_CONFIG_FASTBOOT_ENABLED EQU 1
CYDEV_CONFIG_UNUSED_IO_AllowButWarn EQU 0
CYDEV_CONFIG_UNUSED_IO EQU CYDEV_CONFIG_UNUSED_IO_AllowButWarn
CYDEV_CONFIG_UNUSED_IO_AllowWithInfo EQU 1
CYDEV_CONFIG_UNUSED_IO_Disallowed EQU 2
CYDEV_CONFIGURATION_COMPRESSED EQU 0
CYDEV_CONFIGURATION_DMA EQU 1
CYDEV_CONFIGURATION_ECC EQU 1
CYDEV_CONFIGURATION_IMOENABLED EQU CYDEV_CONFIG_FASTBOOT_ENABLED
CYDEV_CONFIGURATION_MODE_COMPRESSED EQU 0
CYDEV_CONFIGURATION_MODE_DMA EQU 2
CYDEV_CONFIGURATION_MODE EQU CYDEV_CONFIGURATION_MODE_DMA
CYDEV_CONFIGURATION_MODE_UNCOMPRESSED EQU 1
CYDEV_DEBUG_ENABLE_MASK EQU 0x20
CYDEV_DEBUG_ENABLE_REGISTER EQU CYREG_MLOGIC_DEBUG
CYDEV_DEBUGGING_DPS_Disable EQU 3
CYDEV_DEBUGGING_DPS_JTAG_4 EQU 1
CYDEV_DEBUGGING_DPS_JTAG_5 EQU 0
CYDEV_DEBUGGING_DPS_SWD EQU 2
CYDEV_DEBUGGING_DPS_SWD_SWV EQU 6
CYDEV_DEBUGGING_DPS EQU CYDEV_DEBUGGING_DPS_SWD_SWV
CYDEV_DEBUGGING_ENABLE EQU 0
CYDEV_DEBUGGING_XRES EQU 0
CYDEV_DMA_CHANNELS_AVAILABLE EQU 24
CYDEV_ECC_ENABLE EQU 0
CYDEV_HEAP_SIZE EQU 0x1000
CYDEV_INSTRUCT_CACHE_ENABLED EQU 1
CYDEV_INTR_RISING EQU 0x00000006
CYDEV_IS_EXPORTING_CODE EQU 0
CYDEV_IS_IMPORTING_CODE EQU 0
CYDEV_PROJ_TYPE EQU 0
CYDEV_PROJ_TYPE_BOOTLOADER EQU 1
CYDEV_PROJ_TYPE_LAUNCHER EQU 5
CYDEV_PROJ_TYPE_LOADABLE EQU 2
CYDEV_PROJ_TYPE_LOADABLEANDBOOTLOADER EQU 4
CYDEV_PROJ_TYPE_MULTIAPPBOOTLOADER EQU 3
CYDEV_PROJ_TYPE_STANDARD EQU 0
CYDEV_PROTECTION_ENABLE EQU 1
CYDEV_STACK_SIZE EQU 0x2000
CYDEV_USE_BUNDLED_CMSIS EQU 1
CYDEV_VARIABLE_VDDA EQU 0
CYDEV_VDDA_MV EQU 5000
CYDEV_VDDD_MV EQU 5000
CYDEV_VDDIO0_MV EQU 5000
CYDEV_VDDIO1_MV EQU 5000
CYDEV_VDDIO2_MV EQU 5000
CYDEV_VDDIO3_MV EQU 5000
CYDEV_VIO0_MV EQU 5000
CYDEV_VIO1_MV EQU 5000
CYDEV_VIO2_MV EQU 5000
CYDEV_VIO3_MV EQU 5000
CYIPBLOCK_ARM_CM3_VERSION EQU 0
CYIPBLOCK_P3_ANAIF_VERSION EQU 0
CYIPBLOCK_P3_CAN_VERSION EQU 0
CYIPBLOCK_P3_CAPSENSE_VERSION EQU 0
CYIPBLOCK_P3_COMP_VERSION EQU 0
CYIPBLOCK_P3_DECIMATOR_VERSION EQU 0
CYIPBLOCK_P3_DFB_VERSION EQU 0
CYIPBLOCK_P3_DMA_VERSION EQU 0
CYIPBLOCK_P3_DRQ_VERSION EQU 0
CYIPBLOCK_P3_DSM_VERSION EQU 0
CYIPBLOCK_P3_EMIF_VERSION EQU 0
CYIPBLOCK_P3_I2C_VERSION EQU 0
CYIPBLOCK_P3_LCD_VERSION EQU 0
CYIPBLOCK_P3_LPF_VERSION EQU 0
CYIPBLOCK_P3_OPAMP_VERSION EQU 0
CYIPBLOCK_P3_PM_VERSION EQU 0
CYIPBLOCK_P3_SCCT_VERSION EQU 0
CYIPBLOCK_P3_TIMER_VERSION EQU 0
CYIPBLOCK_P3_USB_VERSION EQU 0
CYIPBLOCK_P3_VIDAC_VERSION EQU 0
CYIPBLOCK_P3_VREF_VERSION EQU 0
CYIPBLOCK_S8_GPIO_VERSION EQU 0
CYIPBLOCK_S8_IRQ_VERSION EQU 0
CYIPBLOCK_S8_SAR_VERSION EQU 0
CYIPBLOCK_S8_SIO_VERSION EQU 0
CYIPBLOCK_S8_UDB_VERSION EQU 0
CYDEV_BOOTLOADER_ENABLE EQU 0

#endif /* INCLUDED_CYFITTERIAR_INC */
